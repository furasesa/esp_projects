## ota_mqtt/main/Kconfig.projbuild
```kconfig
menu "User Configuration"

choice ESP_SMARTCONFIG_TYPE
	prompt "Smartconfig Type"
	default ESP_TOUCH
	help
		Set protocol type of SmartConfig.
		Start SmartConfig method according to the selected type when user select "ESPTouch", "AirKiss",  "ESPTouch and AirKiss" or "ESPTouch V2" type.

config ESP_TOUCH
	bool "ESPTouch"
config AIRKISS
	bool "AirKiss"
config ESP_TOUCH_AIRKISS
	bool "ESPTouch and AirKiss"
config ESP_TOUCH_V2
	bool "ESPTouch-V2"
endchoice

config ESP_SMARTCONFIG_TYPE
	int
	default 0 if ESP_TOUCH
	default 1 if AIRKISS
	default 2 if ESP_TOUCH_AIRKISS
	default 3 if ESP_TOUCH_V2


config DEVICE_NAME
	string "Unique Name"
	default "SILVER0"
	help
		Device Identifier. Used to address topic of MQTT. Desired Topic DEVICE_NAME/GPIO


config BROKER_URL
    string "Broker URL"
    default "mqtt://192.168.1.200:1083"
    help
        URL of the broker to connect to

config FIRMWARE_UPGRADE_URL
    string "firmware upgrade url endpoint"
    default "https://192.168.1.200:8070/silver0_ota.bin"
    help
        URL of server which hosts the firmware
        image.

endmenu
```
